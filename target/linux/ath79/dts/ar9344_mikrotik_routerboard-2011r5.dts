// SPDX-License-Identifier: GPL-2.0-or-later OR MIT

#include "ar9344_mikrotik_routerboard-2011.dtsi"

/ {
	compatible = "mikrotik,routerboard-2011r5", "qca,ar9344";
	model = "MikroTik RouterBOARD 2011UiAS";
};
